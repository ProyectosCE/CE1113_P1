## layers/meta-red/conf/layer.conf
```bitbake
BBPATH .= ":${LAYERDIR}"
BBFILES += "${LAYERDIR}/recipes-*/*/*.bb \
            ${LAYERDIR}/recipes-*/*/*.bbappend"

BBFILE_COLLECTIONS += "red"
BBFILE_PATTERN_red = "^${LAYERDIR}/"
BBFILE_PRIORITY_red = "6"

LAYERVERSION_red = "1"
LAYERDEPENDS_red = "core ce1113 raspberrypi"
LAYERSERIES_COMPAT_red = "scarthgap"
```

## layers/meta-server/conf/layer.conf
```bitbake
BBPATH .= ":${LAYERDIR}"

BBFILES += "${LAYERDIR}/recipes-*/*/*.bb \
            ${LAYERDIR}/recipes-*/*/*.bbappend"

BBFILE_COLLECTIONS += "server"
BBFILE_PATTERN_server = "^${LAYERDIR}/"
BBFILE_PRIORITY_server = "7"

LAYERVERSION_server = "1"

LAYERDEPENDS_server = "core ce1113"

LAYERSERIES_COMPAT_server = "scarthgap"
```

## rpi4/conf/bblayers.conf
```bitbake
# POKY_BBLAYERS_CONF_VERSION is increased each time build/conf/bblayers.conf
# changes incompatibly
POKY_BBLAYERS_CONF_VERSION = "2"

BBPATH = "${TOPDIR}"
BBFILES ?= ""

BBLAYERS ?= " \
  /home/jecampos/poky-scarthgap-5.0.19/meta \
  /home/jecampos/poky-scarthgap-5.0.19/meta-poky \
  /home/jecampos/poky-scarthgap-5.0.19/meta-yocto-bsp \
  /home/jecampos/poky-scarthgap-5.0.19/meta-raspberrypi \
  /home/jecampos/poky-scarthgap-5.0.19/meta-openembedded/meta-oe \
  /home/jecampos/poky-scarthgap-5.0.19/meta-openembedded/meta-python \
  /home/jecampos/poky-scarthgap-5.0.19/meta-openembedded/meta-multimedia \
  "
```
